## drivers/usb/common/usbip/Kconfig
```kconfig
config USBIP
	bool

config USBIP_SERVER
	bool "USB/IP Server"
	default y
	depends on UDC_NATIVE_POSIX
	select USBIP

config USBIP_SERVER_MAX_CONNECTIONS
	int "Maximum simultaneous USB/IP Server connections"
	default 8
	depends on USBIP_SERVER

config USBIP_SERVER_PORT
	int "USB/IP Server listening port"
	default 3240
	depends on USBIP_SERVER
```

## drivers/usb/udc/Kconfig.native_posix
```kconfig
# Copyright (c) 2023 Nordic Semiconductor ASA
# SPDX-License-Identifier: Apache-2.0

config UDC_NATIVE_POSIX
	bool "Native POSIX USB device controller driver"
	default y
	depends on DT_HAS_ZEPHYR_NATIVE_POSIX_UDC_ENABLED
	help
	  Native POSIX USB device controller driver.

config UDC_NATIVE_POSIX_STACK_SIZE
	int "UDC native POSIX driver internal thread stack size"
	depends on UDC_NATIVE_POSIX
	default 512
	help
	  Native POSIX driver internal thread stack size.

config UDC_NATIVE_POSIX_THREAD_PRIORITY
	int "UDC native POSIX driver thread priority"
	depends on UDC_NATIVE_POSIX
	default 8
	help
	  Native POSIX driver thread priority.

config UDC_POSX_NATIVE_MAX_QMESSAGES
	int
	depends on UDC_NATIVE_POSIX
	default 8
```

## dts/bindings/usb/zephyr,usbip-host.yaml
```yaml
# Copyright (c) 2022 Nordic Semiconductor ASA
# SPDX-License-Identifier: Apache-2.0

description: USBIP Host Controller Interface

compatible: "zephyr,usbip-host"

include: base.yaml

bus: usb

properties:
  device:
    type: phandle
    description: References to device to export
```

## subsys/usb/host/usbip/Kconfig
```kconfig
# Copyright (c) 2022 Nordic Semiconductor ASA
#
# SPDX-License-Identifier: Apache-2.0

config USBH_USBIP
	bool "USB/IP host"
    depends on USB_HOST_STACK
    depends on DT_HAS_ZEPHYR_USBIP_HOST_ENABLED
	help
		USB/IP host stack support

config USBH_USBIP_MAX_URB_SIZE
	int
	depends on USBH_USBIP
	default 512
	help
		Maximum size of a single URB 


config USBH_USBIP_URB_COUNT
	int
	depends on USBH_USBIP
	default	8
	help
		Maximum number of outstanding URBs

config USBH_USBIP_MAX_DEVICE_COUNT
	int
	depends on USBH_USBIP
	default	8
	help
		Maximum number of USB/IP devices

config USBH_USBIP_SERVER_PORT
	int
	default 3240

config USBH_USBIP_SERVER_THREAD_PRIO
	int
	default 2

config USBH_USBIP_SERVER_MAX_CONNECTIONS
	int
	default 2
```
